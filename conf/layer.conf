## conf/layer.conf
```bitbake
# We have a conf and classes directory, add to BBPATH

BBPATH .= ":${LAYERDIR}"

# We have recipes-* directories, add to BBFILES
BBFILES += "${LAYERDIR}/recipes-*/*/*.bb \
            ${LAYERDIR}/recipes-*/*/*.bbappend"

BBFILE_COLLECTIONS += "meta-santhosh"
BBFILE_PATTERN_meta-santhosh = "^${LAYERDIR}/"
BBFILE_PRIORITY_meta-santhosh = "10"

LAYERDEPENDS_meta-santhosh = "core"
LAYERSERIES_COMPAT_meta-santhosh = "kirkstone"
```
